## CMakeLists.txt
```
# SPDX-FileCopyrightText: Copyright (c) 2026 Silicon Laboratories Inc.
# SPDX-License-Identifier: Apache-2.0

cmake_minimum_required(VERSION 3.28.0)

find_package(Zephyr REQUIRED HINTS $ENV{ZEPHYR_BASE})
project(host_cmd)

target_sources(app PRIVATE
  src/driver.c
  src/conn_cmds.c
  src/deadline.c
  src/disconnect.c
  src/enable.c
  src/op.c
  src/op_no_reset.c
  src/seq.c
)

# A suite for a central with SMP, which one scenario is
if(CONFIG_BT_SMP AND CONFIG_BT_CENTRAL)
  target_sources(app PRIVATE src/encrypt.c)
endif()

# The suites use internal headers of the Host
target_include_directories(app PRIVATE ${ZEPHYR_BASE}/subsys/bluetooth/host)
```

## prj.conf
```kconfig
CONFIG_ZTEST=y

CONFIG_BT=y
CONFIG_BT_LL_SW_SPLIT=n
CONFIG_BT_H4=n
CONFIG_BT_PERIPHERAL=y

# The suites look at what the Host does once the controller stops responding,
# which with asserts is to stop.
CONFIG_ASSERT=n
CONFIG_BT_ASSERT=n

CONFIG_LOG=y

# Lets the suites check that the command pool counts its buffers right
CONFIG_NET_BUF_POOL_USAGE=y

# The suites are picked by what the test controller is like, see
# TEST_DRIVER_RESETS: no scenario runs all of them.
CONFIG_ZTEST_VERIFY_RUN_ALL=n

# For the suite of the commands of a connection: a second command when a
# connection comes up, and no parameter update that the Host starts on its
# own unless the application has asked for one.
CONFIG_BT_AUTO_PHY_PERIPHERAL_2M=y
CONFIG_BT_GAP_AUTO_UPDATE_CONN_PARAMS=n
```

## src/conn_cmds.c
```c
/*
 * SPDX-FileCopyrightText: Copyright (c) 2026 Silicon Laboratories Inc.
 * SPDX-License-Identifier: Apache-2.0
 */

/* A connection sends the HCI commands that the Host starts on its own through
 * one command operation, one at a time. These cases cover what that means for
 * commands that are asked for while another one is outstanding: their order,
 * what a disconnection leaves of them, and a command that is asked for more
 * than once. A caller that needs the response of the controller sends the
 * same command from its stack instead, and gets that response.
 */

#include <errno.h>
#include <stdint.h>
#include <string.h>

#include <zephyr/bluetooth/bluetooth.h>
#include <zephyr/bluetooth/conn.h>
#include <zephyr/bluetooth/hci.h>
#include <zephyr/bluetooth/hci_types.h>
#include <zephyr/kernel.h>
#include <zephyr/sys/byteorder.h>
#include <zephyr/sys/util.h>
#include <zephyr/ztest.h>

#include "conn_internal.h"
#include "hci_core.h"

#include "driver.h"

/* A scripted response that comes later than test_settle() returns, so that a
 * case sees the Host while it waits for it
 */
#define RSP_DELAY_MS 50U

/* The parameters of the updates that the cases ask for, which the interval,
 * in units of 1.25 ms, tells apart: no latency, and a supervision timeout of
 * 4 s in units of 10 ms
 */
#define FIRST_INTERVAL  30U
#define SECOND_INTERVAL 40U
#define THIRD_INTERVAL  50U
#define UPDATE_PARAM(interval) BT_LE_CONN_PARAM((interval), (interval), 0U, 400U)

/* With these the Host of a peripheral reads the remote features and asks for
 * the 2M PHY once a connection is up, and updates the connection parameters
 * with a command rather than over L2CAP.
 */
static const uint8_t le_features[8] = {
	BIT(BT_LE_FEAT_BIT_CONN_PARAM_REQ) | BIT(BT_LE_FEAT_BIT_PER_INIT_FEAT_XCHG),
	/* The second octet has the bits from 8 on */
	BIT(BT_LE_FEAT_BIT_PHY_2M - 8),
};

static K_SEM_DEFINE(connected_sem, 0, 1);
static K_SEM_DEFINE(disconnected_sem, 0, 1);
static struct bt_conn *conn;
static bool is_running;

static void connected(struct bt_conn *new_conn, uint8_t err)
{
	ARG_UNUSED(err);

	/* A connection of another suite */
	if (!is_running) {
		return;
	}

	conn = bt_conn_ref(new_conn);
	k_sem_give(&connected_sem);
}

static void disconnected(struct bt_conn *old_conn, uint8_t reason)
{
	ARG_UNUSED(reason);

	if (!is_running || old_conn != conn) {
		return;
	}

	bt_conn_drop(&conn);
	k_sem_give(&disconnected_sem);
}

BT_CONN_CB_DEFINE(conn_cmds_callbacks) = {
	.connected = connected,
	.disconnected = disconnected,
};

static void connect(void)
{
	zassert_ok(bt_le_adv_start(BT_LE_ADV_CONN_FAST_1, NULL, 0U, NULL, 0U),
		   "Advertising failed to start");

	/* What the controller is given from here on is for the connection */
	test_log_len = 0U;
	test_connect();
	zassert_ok(k_sem_take(&connected_sem, TEST_TIMEOUT), "No connection");
}

static enum bt_conn_state conn_state(void)
{
	struct bt_conn_info info;

	zassert_ok(bt_conn_get_info(conn, &info), "No connection info");

	return info.state;
}

static void count_conn(struct bt_conn *counted, void *data)
{
	unsigned int *count = data;

	ARG_UNUSED(counted);

	(*count)++;
}

/* The connection objects that somebody holds a reference to */
static unsigned int conn_count(void)
{
	unsigned int count = 0U;

	bt_conn_foreach(BT_CONN_TYPE_LE, count_conn, &count);

	return count;
}

/* The commands of the connection among what the controller has been given */
static bool is_conn_cmd(uint16_t opcode)
{
	return opcode == BT_HCI_OP_DISCONNECT || opcode == BT_HCI_OP_LE_READ_REMOTE_FEATURES ||
	       opcode == BT_HCI_OP_LE_SET_PHY || opcode == BT_HCI_OP_LE_CONN_UPDATE;
}

static void expect_sent(const uint16_t *opcodes, size_t count)
{
	size_t found = 0U;

	zassert_true(test_log_len <= ARRAY_SIZE(test_log), "More commands than the log holds");

	for (unsigned int idx = 0U; idx < test_log_len; idx++) {
		if (!is_conn_cmd(test_log[idx])) {
			continue;
		}

		zassert_true(found < count, "Command 0x%04x was not expected", test_log[idx]);
		zassert_equal(test_log[idx], opcodes[found], "Command %zu is 0x%04x, not 0x%04x",
			      found, test_log[idx], opcodes[found]);
		found++;
	}

	zassert_equal(found, count, "%zu commands of the connection, not %zu", found, count);
}

#define EXPECT_SENT(...)                                                                           \
	do {                                                                                       \
		static const uint16_t expected[] = {0U, __VA_ARGS__};                              \
												   \
		expect_sent(&expected[1], ARRAY_SIZE(expected) - 1U);                              \
	} while (false)

static void before(void *fixture)
{
	ARG_UNUSED(fixture);

	/* The controller is only asked for its features when it is enabled */
	if (bt_is_ready()) {
		zassert_ok(bt_disable(), "Bluetooth disable failed");
	}

	test_driver_reset();
	(void)memcpy(test_le_features, le_features, sizeof(test_le_features));
	k_sem_reset(&connected_sem);
	k_sem_reset(&disconnected_sem);
	is_running = true;

	zassert_ok(bt_enable(NULL), "Bluetooth init failed");
}

static void after(void *fixture)
{
	ARG_UNUSED(fixture);

	test_cmd_bufs_release();

	/* Whatever is left of the connection goes with the disable */
	test_driver_release();
	zassert_ok(bt_disable(), "Bluetooth disable failed");
	(void)memset(test_le_features, 0, sizeof(test_le_features));
	is_running = false;

	bt_conn_drop(&conn);
}

ZTEST_SUITE(conn_cmds, test_with_reset, NULL, before, after, NULL);

/* While a command of the connection is outstanding the others wait, and then
 * go out in their own order, not in the order they were asked for in: the
 * disconnect that came last is sent first, and it leaves nothing to send.
 */
static ZTEST(conn_cmds, test_one_at_a_time)
{
	test_other_opcode = BT_HCI_OP_LE_READ_REMOTE_FEATURES;
	test_other.delay = K_FOREVER;

	connect();
	test_settle();
	EXPECT_SENT(BT_HCI_OP_LE_READ_REMOTE_FEATURES);

	zassert_ok(bt_conn_disconnect(conn, BT_HCI_ERR_REMOTE_USER_TERM_CONN),
		   "The request was refused");
	test_settle();
	EXPECT_SENT(BT_HCI_OP_LE_READ_REMOTE_FEATURES);
	zassert_equal(conn_state(), BT_CONN_STATE_DISCONNECTING, "Wrong state while requested");

	test_cmd_respond(&test_other);
	zassert_ok(k_sem_take(&disconnected_sem, TEST_TIMEOUT), "No disconnection");
	test_settle();
	EXPECT_SENT(BT_HCI_OP_LE_READ_REMOTE_FEATURES, BT_HCI_OP_DISCONNECT);
}

/* A disconnect that the controller rejects leaves the connection up, and the
 * command that waited behind it is sent after all.
 */
static ZTEST(conn_cmds, test_rejected_disconnect)
{
	test_other_opcode = BT_HCI_OP_LE_READ_REMOTE_FEATURES;
	test_other.delay = K_FOREVER;
	test_disconnect.status = BT_HCI_ERR_CMD_DISALLOWED;

	connect();
	test_settle();

	zassert_ok(bt_conn_disconnect(conn, BT_HCI_ERR_REMOTE_USER_TERM_CONN),
		   "The request was refused");
	test_cmd_respond(&test_other);
	test_settle();

	EXPECT_SENT(BT_HCI_OP_LE_READ_REMOTE_FEATURES, BT_HCI_OP_DISCONNECT, BT_HCI_OP_LE_SET_PHY);
	zassert_equal(conn_state(), BT_CONN_STATE_CONNECTED, "Wrong state after the rejection");
	zassert_equal(k_sem_count_get(&disconnected_sem), 0U, "The connection was reported gone");
}

/* The peer disconnects while one command is outstanding and another waits.
 * The one that waits is dropped. The outstanding one keeps the connection
 * object until its response comes, so that the response finds what it is
 * about.
 */
static ZTEST(conn_cmds, test_peer_disconnects)
{
	test_other_opcode = BT_HCI_OP_LE_READ_REMOTE_FEATURES;
	test_other.delay = K_FOREVER;

	connect();
	test_settle();

	test_disconnect_complete(BT_HCI_ERR_REMOTE_USER_TERM_CONN);
	zassert_ok(k_sem_take(&disconnected_sem, TEST_TIMEOUT), "No disconnection");
	test_settle();
	EXPECT_SENT(BT_HCI_OP_LE_READ_REMOTE_FEATURES);

	zassert_equal(conn_count(), 1U, "The connection object was released under its command");

	test_cmd_respond(&test_other);
	test_settle();
	EXPECT_SENT(BT_HCI_OP_LE_READ_REMOTE_FEATURES);
	zassert_equal(conn_count(), 0U, "The connection object was not released");

	/* The next connection starts from nothing */
	test_other.delay = K_NO_WAIT;
	connect();
	test_settle();
	EXPECT_SENT(BT_HCI_OP_LE_READ_REMOTE_FEATURES, BT_HCI_OP_LE_SET_PHY);
}

/* When the controller stops responding, the commands that wait behind the
 * outstanding one are dropped: the connection has nothing left to send, and
 * a command that it is asked for then is refused.
 */
static ZTEST(conn_cmds, test_dropped_with_controller)
{
	test_other_opcode = BT_HCI_OP_LE_READ_REMOTE_FEATURES;
	test_other.delay = K_FOREVER;

	connect();
	test_settle();

	zassert_ok(bt_conn_le_conn_update_nowait(conn, UPDATE_PARAM(FIRST_INTERVAL)),
		   "The update was refused");
	zassert_true(atomic_test_bit(conn->flags, BT_CONN_CMD_AUTO_PHY), "No PHY update waits");
	zassert_true(atomic_test_bit(conn->flags, BT_CONN_CMD_CONN_UPDATE), "No update waits");

	zassert_true(WAIT_FOR(!atomic_test_bit(conn->flags, BT_CONN_CMD_BUSY),
			      (TEST_DEADLINE_MS + MSEC_PER_SEC) * USEC_PER_MSEC, test_settle()),
		     "The outstanding command was not given up");

	zassert_false(atomic_test_bit(conn->flags, BT_CONN_CMD_AUTO_PHY), "A PHY update waits");
	zassert_false(atomic_test_bit(conn->flags, BT_CONN_CMD_CONN_UPDATE), "An update waits");
	EXPECT_SENT(BT_HCI_OP_LE_READ_REMOTE_FEATURES);

	zassert_equal(bt_conn_le_conn_update_nowait(conn, UPDATE_PARAM(FIRST_INTERVAL)),
		      -EHOSTDOWN, "The update was not refused");
}

/* A command that no command buffer comes free for before the command
 * deadline is given up, and its done function is told so. It is not sent
 * once a buffer is free again.
 */
static ZTEST(conn_cmds, test_given_up_not_sent)
{
	connect();
	test_settle();
	test_log_len = 0U;

	/* The done function of the update clears the flag, which tells the
	 * case when it has run.
	 */
	atomic_set_bit(conn->flags, BT_CONN_PERIPHERAL_PARAM_AUTO_UPDATE);

	zassert_true(test_cmd_bufs_hold() > 0U, "No command buffer was free");
	zassert_ok(bt_conn_le_conn_update_nowait(conn, UPDATE_PARAM(FIRST_INTERVAL)),
		   "The update was refused");
	zassert_true(WAIT_FOR(!atomic_test_bit(conn->flags, BT_CONN_PERIPHERAL_PARAM_AUTO_UPDATE),
			      (TEST_DEADLINE_MS + MSEC_PER_SEC) * USEC_PER_MSEC, test_settle()),
		     "The update was not given up");

	test_cmd_bufs_release();
	test_settle();
	EXPECT_SENT();
	zassert_false(bt_hci_cmd_op_is_pending(&conn->cmd_op), "A command is on its way");
	zassert_false(atomic_test_bit(conn->flags, BT_CONN_CMD_BUSY), "The operation is busy");
}

/* A Disconnection Complete takes back the command that waits for a command
 * credit, and the connection object is left with no command on its way: the
 * next connection on it can send its own.
 */
static ZTEST(conn_cmds, test_taken_back_at_disconnection)
{
	struct bt_conn *gone;
	bool is_pending;
	bool is_busy;

	zassert_ok(bt_le_adv_start(BT_LE_ADV_CONN_FAST_1, NULL, 0U, NULL, 0U),
		   "Advertising failed to start");

	/* The first command of the connection is encoded and waits in the
	 * command queue for a credit.
	 */
	test_credit_revoke();
	test_connect();
	zassert_ok(k_sem_take(&connected_sem, TEST_TIMEOUT), "No connection");
	test_settle();
	zassert_true(bt_hci_cmd_op_is_pending(&conn->cmd_op), "No command waits");
	gone = bt_conn_ref(conn);

	test_disconnect_complete(BT_HCI_ERR_REMOTE_USER_TERM_CONN);
	zassert_ok(k_sem_take(&disconnected_sem, TEST_TIMEOUT), "No disconnection");

	is_pending = bt_hci_cmd_op_is_pending(&gone->cmd_op);
	is_busy = atomic_test_bit(gone->flags, BT_CONN_CMD_BUSY);
	bt_conn_unref(gone);

	/* For what follows, also when the case fails */
	test_credit_grant();

	zassert_false(is_pending, "The command was not taken back");
	zassert_false(is_busy, "BT_CONN_CMD_BUSY is set with no command on its way");
	EXPECT_SENT();
}

/* The interval of the HCI LE Connection Update command that the controller
 * got last: Conn_Interval_Min follows the Connection_Handle.
 */
static uint16_t updated_interval(void)
{
	return sys_get_le16(&test_other_params[2]);
}

/* Commands that wait at the same time go out in the order that the connection
 * has them in, here the PHY update before the parameter update. No in-tree
 * caller asks for two of them in the other order, so that the order is not
 * that of the requests is not covered.
 */
static ZTEST(conn_cmds, test_waiting_in_order)
{
	test_other_opcode = BT_HCI_OP_LE_READ_REMOTE_FEATURES;
	test_other.delay = K_FOREVER;

	connect();
	test_settle();

	zassert_ok(bt_conn_le_conn_update_nowait(conn, UPDATE_PARAM(FIRST_INTERVAL)),
		   "The update was refused");
	test_settle();
	EXPECT_SENT(BT_HCI_OP_LE_READ_REMOTE_FEATURES);

	test_cmd_respond(&test_other);
	test_settle();
	EXPECT_SENT(BT_HCI_OP_LE_READ_REMOTE_FEATURES, BT_HCI_OP_LE_SET_PHY,
		    BT_HCI_OP_LE_CONN_UPDATE);
}

/* A command that is asked for again before it has been sent is sent once,
 * with the parameters that the connection has by then.
 */
static ZTEST(conn_cmds, test_asked_twice_sent_once)
{
	connect();
	test_settle();
	test_log_len = 0U;

	test_other_opcode = BT_HCI_OP_LE_CONN_UPDATE;
	test_other.delay = K_FOREVER;

	zassert_ok(bt_conn_le_conn_update_nowait(conn, UPDATE_PARAM(FIRST_INTERVAL)),
		   "The first update was refused");
	test_settle();
	EXPECT_SENT(BT_HCI_OP_LE_CONN_UPDATE);

	zassert_ok(bt_conn_le_conn_update_nowait(conn, UPDATE_PARAM(SECOND_INTERVAL)),
		   "The second update was refused");
	zassert_ok(bt_conn_le_conn_update_nowait(conn, UPDATE_PARAM(THIRD_INTERVAL)),
		   "The third update was refused");
	test_settle();
	EXPECT_SENT(BT_HCI_OP_LE_CONN_UPDATE);

	test_cmd_respond(&test_other);
	test_settle();
	EXPECT_SENT(BT_HCI_OP_LE_CONN_UPDATE, BT_HCI_OP_LE_CONN_UPDATE);
	zassert_equal(updated_interval(), THIRD_INTERVAL, "Updated to an interval of %u",
		      updated_interval());

	test_cmd_respond(&test_other);
	test_settle();
	EXPECT_SENT(BT_HCI_OP_LE_CONN_UPDATE, BT_HCI_OP_LE_CONN_UPDATE);
}

/* Nobody waits for an update that the Host starts on its own. When the
 * controller refuses it, the connection stays as it is and goes on with the
 * next command that it is asked for.
 */
static ZTEST(conn_cmds, test_own_update_refused)
{
	connect();
	test_settle();
	test_log_len = 0U;

	test_other_opcode = BT_HCI_OP_LE_CONN_UPDATE;
	test_other.status = BT_HCI_ERR_CMD_DISALLOWED;

	zassert_ok(bt_conn_le_conn_update_nowait(conn, UPDATE_PARAM(FIRST_INTERVAL)),
		   "The update was refused");
	test_settle();
	EXPECT_SENT(BT_HCI_OP_LE_CONN_UPDATE);
	zassert_equal(conn_state(), BT_CONN_STATE_CONNECTED, "Wrong state after the refusal");

	test_other.status = BT_HCI_ERR_SUCCESS;

	zassert_ok(bt_conn_le_conn_update_nowait(conn, UPDATE_PARAM(SECOND_INTERVAL)),
		   "The next update was refused");
	test_settle();
	EXPECT_SENT(BT_HCI_OP_LE_CONN_UPDATE, BT_HCI_OP_LE_CONN_UPDATE);
	zassert_equal(updated_interval(), SECOND_INTERVAL, "Updated to an interval of %u",
		      updated_interval());
}

/* Wait until the time that a peripheral waits before it asks for other
 * parameters has passed, which the work of the connection marks at its end
 */
static void wait_param_update_timeout(void)
{
	zassert_true(WAIT_FOR(atomic_test_bit(conn->flags, BT_CONN_PERIPHERAL_PARAM_UPDATE),
			      (CONFIG_BT_CONN_PARAM_UPDATE_TIMEOUT + MSEC_PER_SEC) * USEC_PER_MSEC,
			      test_settle()),
		     "The time before an update did not pass");
}

/* Bring a connection up to where bt_conn_le_param_update() sends a command:
 * the peer has the procedure too, and the time that a peripheral waits before
 * it asks for other parameters has passed.
 */
static void connect_for_param_update(void)
{
	connect();
	test_remote_features(le_features);
	wait_param_update_timeout();

	test_log_len = 0U;
}

/* bt_conn_le_param_update() returns what the controller responded with,
 * which it waits for.
 */
static ZTEST(conn_cmds, test_update_returns_answer)
{
	int64_t start;
	int err;

	connect_for_param_update();

	test_other_opcode = BT_HCI_OP_LE_CONN_UPDATE;
	test_other.delay = K_MSEC(RSP_DELAY_MS);

	start = k_uptime_get();
	zassert_ok(bt_conn_le_param_update(conn, UPDATE_PARAM(FIRST_INTERVAL)),
		   "The update failed");
	zassert_true(k_uptime_get() - start >= RSP_DELAY_MS,
		     "Returned before the controller responded");
	zassert_equal(updated_interval(), FIRST_INTERVAL, "Updated to an interval of %u",
		      updated_interval());

	test_other.status = BT_HCI_ERR_INVALID_PARAM;
	err = bt_conn_le_param_update(conn, UPDATE_PARAM(SECOND_INTERVAL));
	zassert_equal(err, -EINVAL, "Invalid parameters gave %d", err);

	test_other.status = BT_HCI_ERR_CMD_DISALLOWED;
	err = bt_conn_le_param_update(conn, UPDATE_PARAM(THIRD_INTERVAL));
	zassert_equal(err, -EACCES, "A disallowed command gave %d", err);

	EXPECT_SENT(BT_HCI_OP_LE_CONN_UPDATE, BT_HCI_OP_LE_CONN_UPDATE, BT_HCI_OP_LE_CONN_UPDATE);
	zassert_equal(conn_state(), BT_CONN_STATE_CONNECTED, "Wrong state after the refusals");
}

static K_SEM_DEFINE(syswq_update_done, 0, 1);
static int syswq_update_err;

static void syswq_update_handler(struct k_work *work)
{
	ARG_UNUSED(work);

	syswq_update_err = bt_conn_le_param_update(conn, UPDATE_PARAM(FIRST_INTERVAL));
	k_sem_give(&syswq_update_done);
}

static K_WORK_DEFINE(syswq_update_work, syswq_update_handler);

/* The same from the system workqueue, where callers in the tree are and
 * where the TX processor runs in one scenario of this suite.
 */
static ZTEST(conn_cmds, test_update_from_system_workqueue)
{
	connect_for_param_update();

	test_other_opcode = BT_HCI_OP_LE_CONN_UPDATE;
	test_other.status = BT_HCI_ERR_INVALID_PARAM;

	k_sem_reset(&syswq_update_done);
	zassert_true(k_work_submit(&syswq_update_work) >= 0, "Starting the caller failed");
	zassert_ok(k_sem_take(&syswq_update_done, TEST_TIMEOUT), "The caller did not return");
	zassert_equal(syswq_update_err, -EINVAL, "Invalid parameters gave %d", syswq_update_err);
	EXPECT_SENT(BT_HCI_OP_LE_CONN_UPDATE);
}

/* A caller that still has the connection object after the connection is
 * gone is told so, and the controller is not given a command for it.
 */
static ZTEST(conn_cmds, test_update_after_disconnection)
{
	struct bt_conn *gone;
	int err;

	connect_for_param_update();
	gone = bt_conn_ref(conn);

	test_disconnect_complete(BT_HCI_ERR_REMOTE_USER_TERM_CONN);
	zassert_ok(k_sem_take(&disconnected_sem, TEST_TIMEOUT), "No disconnection");

	err = bt_conn_le_param_update(gone, UPDATE_PARAM(FIRST_INTERVAL));
	bt_conn_unref(gone);

	zassert_equal(err, -ENOTCONN, "The update gave %d", err);
	EXPECT_SENT();
}

/* A peripheral that is asked for other parameters right after the connection
 * came up keeps them until the time that it waits before an update has
 * passed. The Host then sends the command on its own.
 */
static ZTEST(conn_cmds, test_update_at_timeout)
{
	test_other_opcode = BT_HCI_OP_LE_CONN_UPDATE;

	connect();
	test_remote_features(le_features);
	zassert_ok(bt_conn_le_param_update(conn, UPDATE_PARAM(FIRST_INTERVAL)),
		   "The update was refused");
	test_settle();
	EXPECT_SENT(BT_HCI_OP_LE_READ_REMOTE_FEATURES, BT_HCI_OP_LE_SET_PHY);

	wait_param_update_timeout();
	test_settle();
	EXPECT_SENT(BT_HCI_OP_LE_READ_REMOTE_FEATURES, BT_HCI_OP_LE_SET_PHY,
		    BT_HCI_OP_LE_CONN_UPDATE);
	zassert_equal(updated_interval(), FIRST_INTERVAL, "Updated to an interval of %u",
		      updated_interval());
}
```

## src/driver.c
```c
/*
 * SPDX-FileCopyrightText: Copyright (c) 2026 Silicon Laboratories Inc.
 * SPDX-License-Identifier: Apache-2.0
 */

/* A scriptable controller behind an HCI driver, for tests of the Host's HCI
 * command handling. It responds to the initialization commands as far as the
 * Host needs, and lets a test decide when and how it responds to two commands.
 */

#include <errno.h>
#include <stddef.h>
#include <stdint.h>
#include <string.h>

#include <zephyr/bluetooth/addr.h>
#include <zephyr/bluetooth/buf.h>
#include <zephyr/bluetooth/gap.h>
#include <zephyr/bluetooth/hci.h>
#include <zephyr/bluetooth/hci_types.h>
#include <zephyr/device.h>
#include <zephyr/devicetree.h>
#include <zephyr/drivers/bluetooth.h>
#include <zephyr/kernel.h>
#include <zephyr/net_buf.h>
#include <zephyr/sys/byteorder.h>
#include <zephyr/sys/util.h>
#include <zephyr/ztest.h>

#include "hci_core.h"

#include "driver.h"

#define DT_DRV_COMPAT zephyr_bt_hci_test

/* Large enough for the return parameters of initialization commands that are
 * irrelevant to these tests, of which Read Local Supported Commands is the
 * largest.
 */
#define GENERIC_RP_SIZE sizeof(struct bt_hci_rp_read_supported_commands)

/* The LE ACL buffers of the controller: the smallest size there is, and a
 * few of them
 */
#define LE_ACL_MAX_LEN 27U
#define LE_ACL_MAX_NUM 3U

/* An L2CAP header: the length and the channel */
#define L2CAP_HDR_LEN 4U

struct test_cmd_script test_cmd;
struct test_cmd_script test_disconnect;
struct test_cmd_script test_other;
uint16_t test_other_opcode;
uint8_t test_other_params[TEST_OTHER_PARAMS_MAX];
uint16_t test_log[TEST_LOG_MAX];
unsigned int test_log_len;
uint8_t test_le_features[TEST_LE_FEATURES_LEN];
unsigned int test_acl_count;
uint8_t test_acl_data[TEST_ACL_DATA_MAX];
uint8_t test_cmd_plen[TEST_CMD_PLEN_MAX];
unsigned int test_reset_count;
unsigned int test_close_count;
struct net_buf *test_cmd_bufs[TEST_CMD_BUF_MAX];

/* Given whenever a scripted command arrives or is responded to */
static K_SEM_DEFINE(script_sem, 0, K_SEM_MAX_LIMIT);

static const struct device *const hci_dev = DEVICE_DT_GET(DT_DRV_INST(0));

/* First parameter byte of the TEST_OPCODE command that the controller got last */
static uint8_t test_cmd_param;

static void *evt_create(struct net_buf **buf, uint8_t evt, uint8_t len)
{
	struct bt_hci_evt_hdr *hdr;

	*buf = bt_buf_get_evt(evt, false, K_FOREVER);
	hdr = net_buf_add(*buf, sizeof(*hdr));
	hdr->evt = evt;
	hdr->len = len;

	return net_buf_add(*buf, len);
}

static void *cmd_complete(struct net_buf **buf, uint16_t opcode, uint8_t ncmd, uint8_t plen)
{
	struct bt_hci_evt_cmd_complete *cc;

	cc = evt_create(buf, BT_HCI_EVT_CMD_COMPLETE, sizeof(*cc) + plen);
	cc->ncmd = ncmd;
	cc->opcode = sys_cpu_to_le16(opcode);
	(void)memset(&cc[1], 0, plen);

	return &cc[1];
}

void test_cmd_respond(struct test_cmd_script *script)
{
	struct net_buf *evt;

	if (script == &test_disconnect || script == &test_other) {
		struct bt_hci_evt_cmd_status *status;

		status = evt_create(&evt, BT_HCI_EVT_CMD_STATUS, sizeof(*status));
		status->status = script->status;
		status->ncmd = script->ncmd;
		status->opcode = sys_cpu_to_le16((script == &test_other) ? test_other_opcode
									  : BT_HCI_OP_DISCONNECT);
		bt_hci_recv(hci_dev, evt);

		if (script == &test_disconnect && script->status == BT_HCI_ERR_SUCCESS) {
			test_disconnect_complete(BT_HCI_ERR_LOCALHOST_TERM_CONN);
		}
	} else {
		uint8_t *rp;

		rp = cmd_complete(&evt, TEST_OPCODE, script->ncmd, 1U + script->rp_len);
		rp[0] = script->status;
		for (uint8_t i = 0U; i < script->rp_len; i++) {
			rp[1U + i] = script->echo ? test_cmd_param : i;
		}

		bt_hci_recv(hci_dev, evt);
	}

	script->rsp_count++;
	k_sem_give(&script_sem);
}

static int script_wait(const unsigned int *counter, unsigned int count)
{
	while (*counter < count) {
		if (k_sem_take(&script_sem, TEST_TIMEOUT) != 0) {
			return -EAGAIN;
		}
	}

	return 0;
}

int test_cmd_wait(const struct test_cmd_script *script, unsigned int count)
{
	return script_wait(&script->count, count);
}

int test_rsp_wait(const struct test_cmd_script *script, unsigned int count)
{
	return script_wait(&script->rsp_count, count);
}

static K_SEM_DEFINE(flush_sem, 0, 1);

static void flush_handler(struct k_work *work)
{
	ARG_UNUSED(work);

	k_sem_give(&flush_sem);
}

static K_WORK_DEFINE(flush_work, flush_handler);

/* A queue runs its work items in order: the flush work item runs once what
 * was submitted before it has.
 */
static void flush_wait(int submit_err)
{
	struct k_work_sync sync;

	zassert_true(submit_err >= 0, "Submitting the flush failed (err %d)", submit_err);
	zassert_ok(k_sem_take(&flush_sem, TEST_TIMEOUT), "The queue is stuck");

	/* The queue is done with the work item too, for the next flush */
	(void)k_work_flush(&flush_work, &sync);
}

void test_workq_flush(struct k_work_q *queue)
{
	flush_wait(k_work_submit_to_queue(queue, &flush_work));
}

void test_bt_workq_flush(void)
{
	flush_wait(bt_work_submit(&flush_work));
}

void test_settle(void)
{
	/* No time passes on native_sim while a thread runs, so a sleep of one
	 * tick returns only once every thread that was ready has run until it
	 * waits.
	 */
	(void)k_sleep(K_TICKS(1));
}

unsigned int test_cmd_bufs_hold(void)
{
	unsigned int count = 0U;

	ARRAY_FOR_EACH(test_cmd_bufs, i) {
		test_cmd_bufs[i] = bt_hci_cmd_alloc(K_NO_WAIT);
		if (test_cmd_bufs[i] == NULL) {
			break;
		}

		count++;
	}

	zassert_true(count < ARRAY_SIZE(test_cmd_bufs),
		     "The Host has more command buffers than expected");

	return count;
}

void test_cmd_bufs_release(void)
{
	ARRAY_FOR_EACH(test_cmd_bufs, i) {
		net_buf_drop(&test_cmd_bufs[i]);
	}
}

void test_cmd_pool_check(void)
{
	struct net_buf_pool *pool;
	unsigned int count;

	count = test_cmd_bufs_hold();
	zassert_true(count > 0U, "No command buffer is free");
	pool = net_buf_pool_get(test_cmd_bufs[0]->pool_id);
	zassert_equal(count, pool->buf_count, "%u of %u command buffers are free", count,
		      pool->buf_count);
	zassert_equal(atomic_get(&pool->avail_count), 0, "The pool counts %ld free buffers",
		      atomic_get(&pool->avail_count));

	test_cmd_bufs_release();
	zassert_equal(atomic_get(&pool->avail_count), pool->buf_count,
		      "The pool counts %ld free buffers", atomic_get(&pool->avail_count));
}

void test_credit_grant(void)
{
	struct net_buf *evt;

	(void)cmd_complete(&evt, 0U, 1U, 0U);
	bt_hci_recv(hci_dev, evt);
}

void test_credit_revoke(void)
{
	struct net_buf *evt;

	(void)cmd_complete(&evt, 0U, 0U, 0U);
	bt_hci_recv(hci_dev, evt);
}

bool test_with_reset(const void *state)
{
	ARG_UNUSED(state);

	return TEST_DRIVER_RESETS;
}

bool test_without_reset(const void *state)
{
	ARG_UNUSED(state);

	return !TEST_DRIVER_RESETS;
}

static void cmd_rsp_handler(struct k_work *work)
{
	ARG_UNUSED(work);

	test_cmd_respond(&test_cmd);
}

static void disconnect_rsp_handler(struct k_work *work)
{
	ARG_UNUSED(work);

	test_cmd_respond(&test_disconnect);
}

static void other_rsp_handler(struct k_work *work)
{
	ARG_UNUSED(work);

	test_cmd_respond(&test_other);
}

static K_WORK_DELAYABLE_DEFINE(cmd_rsp_work, cmd_rsp_handler);
static K_WORK_DELAYABLE_DEFINE(disconnect_rsp_work, disconnect_rsp_handler);
static K_WORK_DELAYABLE_DEFINE(other_rsp_work, other_rsp_handler);

static void scripted(struct test_cmd_script *script, struct k_work_delayable *work)
{
	script->count++;
	k_sem_give(&script_sem);

	if (K_TIMEOUT_EQ(script->delay, K_NO_WAIT)) {
		test_cmd_respond(script);
	} else if (!K_TIMEOUT_EQ(script->delay, K_FOREVER)) {
		(void)k_work_schedule(work, script->delay);
	} else {
		/* The test responds with test_cmd_respond() */
	}
}

/* A static random address, as its two most significant bits say */
const bt_addr_le_t test_peer = {
	.type = BT_ADDR_LE_RANDOM,
	.a.val = { 0x01U, 0x02U, 0x03U, 0x04U, 0x05U, 0xc6U },
};

static void connect_as(uint8_t role)
{
	struct bt_hci_evt_le_conn_complete *cc;
	struct bt_hci_evt_le_meta_event *meta;
	struct net_buf *evt;

	meta = evt_create(&evt, BT_HCI_EVT_LE_META_EVENT, sizeof(*meta) + sizeof(*cc));
	meta->subevent = BT_HCI_EVT_LE_CONN_COMPLETE;
	cc = (void *)&meta[1];
	(void)memset(cc, 0, sizeof(*cc));
	cc->status = BT_HCI_ERR_SUCCESS;
	cc->handle = sys_cpu_to_le16(TEST_CONN_HANDLE);
	cc->role = role;
	bt_addr_le_copy(&cc->peer_addr, &test_peer);
	cc->interval = sys_cpu_to_le16(BT_GAP_INIT_CONN_INT_MIN);
	/* Any valid value: the test controller does not supervise the connection */
	cc->supv_timeout = sys_cpu_to_le16(BT_GAP_MS_TO_CONN_TIMEOUT(4000U));

	bt_hci_recv(hci_dev, evt);
}

void test_connect(void)
{
	connect_as(BT_HCI_ROLE_PERIPHERAL);
}

void test_connect_central(void)
{
	connect_as(BT_HCI_ROLE_CENTRAL);
}

void test_encrypt_change(uint8_t status)
{
	struct bt_hci_evt_encrypt_change *change;
	struct net_buf *evt;

	change = evt_create(&evt, BT_HCI_EVT_ENCRYPT_CHANGE, sizeof(*change));
	change->status = status;
	change->handle = sys_cpu_to_le16(TEST_CONN_HANDLE);
	change->encrypt = (status == BT_HCI_ERR_SUCCESS) ? 0x01U : 0x00U;

	bt_hci_recv(hci_dev, evt);
}

void test_acl_recv(uint16_t cid, const uint8_t *data, uint8_t len)
{
	struct bt_hci_acl_hdr *acl;
	struct net_buf *buf;

	buf = bt_buf_get_rx(BT_BUF_ACL_IN, K_FOREVER);
	acl = net_buf_add(buf, sizeof(*acl));
	acl->handle = sys_cpu_to_le16(bt_acl_handle_pack(TEST_CONN_HANDLE, BT_ACL_START));
	acl->len = sys_cpu_to_le16(L2CAP_HDR_LEN + len);

	net_buf_add_le16(buf, len);
	net_buf_add_le16(buf, cid);
	(void)net_buf_add_mem(buf, data, len);

	bt_hci_recv(hci_dev, buf);
}

void test_remote_features(const uint8_t features[TEST_LE_FEATURES_LEN])
{
	struct bt_hci_evt_le_remote_feat_complete *complete;
	struct bt_hci_evt_le_meta_event *meta;
	struct net_buf *evt;

	meta = evt_create(&evt, BT_HCI_EVT_LE_META_EVENT, sizeof(*meta) + sizeof(*complete));
	meta->subevent = BT_HCI_EVT_LE_REMOTE_FEAT_COMPLETE;
	complete = (void *)&meta[1];
	complete->status = BT_HCI_ERR_SUCCESS;
	complete->handle = sys_cpu_to_le16(TEST_CONN_HANDLE);
	(void)memcpy(complete->features, features, sizeof(complete->features));

	bt_hci_recv(hci_dev, evt);
}

void test_disconnect_complete(uint8_t reason)
{
	struct bt_hci_evt_disconn_complete *complete;
	struct net_buf *evt;

	complete = evt_create(&evt, BT_HCI_EVT_DISCONN_COMPLETE, sizeof(*complete));
	complete->status = BT_HCI_ERR_SUCCESS;
	complete->handle = sys_cpu_to_le16(TEST_CONN_HANDLE);
	complete->reason = reason;

	bt_hci_recv(hci_dev, evt);
}

/* The command buffer that the controller keeps, see test_cmd_script.keep */
static struct net_buf *kept_cmd;

static void cmd_handle(struct net_buf *cmd)
{
	struct bt_hci_cmd_hdr *chdr;
	struct net_buf *evt;
	uint16_t opcode;
	uint8_t *rp;

	chdr = net_buf_pull_mem(cmd, sizeof(*chdr));
	opcode = sys_le16_to_cpu(chdr->opcode);

	if (test_log_len < ARRAY_SIZE(test_log)) {
		test_log[test_log_len] = opcode;
	}

	test_log_len++;

	if (opcode == test_other_opcode) {
		(void)memset(test_other_params, 0, sizeof(test_other_params));
		(void)memcpy(test_other_params, cmd->data,
			     MIN(cmd->len, sizeof(test_other_params)));
		if (test_other.keep && kept_cmd == NULL) {
			kept_cmd = net_buf_ref(cmd);
		}

		scripted(&test_other, &other_rsp_work);
		return;
	}

	switch (opcode) {
	case TEST_OPCODE:
		if (test_cmd.count < ARRAY_SIZE(test_cmd_plen)) {
			test_cmd_plen[test_cmd.count] = (uint8_t)cmd->len;
		}

		test_cmd_param = (cmd->len > 0U) ? cmd->data[0] : 0U;
		scripted(&test_cmd, &cmd_rsp_work);
		return;
	case BT_HCI_OP_DISCONNECT:
		scripted(&test_disconnect, &disconnect_rsp_work);
		return;
	case BT_HCI_OP_HOST_NUM_COMPLETED_PACKETS:
		/* The one command that a controller does not respond to */
		return;
	case BT_HCI_OP_RESET:
		test_reset_count++;
		break;
	default:
		break;
	}

	rp = cmd_complete(&evt, opcode, 1U, GENERIC_RP_SIZE);

	switch (opcode) {
	case BT_HCI_OP_READ_LOCAL_FEATURES: {
		struct bt_hci_rp_read_local_features *features = (void *)rp;

		/* LE supported and BR/EDR not supported */
		features->features[4] = BIT(5) | BIT(6);
		break;
	}
	case BT_HCI_OP_READ_SUPPORTED_COMMANDS: {
		struct bt_hci_rp_read_supported_commands *commands = (void *)rp;

		(void)memset(commands->commands, 0xFF, sizeof(commands->commands));
		break;
	}
	case BT_HCI_OP_READ_BD_ADDR: {
		struct bt_hci_rp_read_bd_addr *addr = (void *)rp;

		(void)memset(&addr->bdaddr, 0x11, sizeof(addr->bdaddr));
		break;
	}
	case BT_HCI_OP_LE_READ_BUFFER_SIZE: {
		struct bt_hci_rp_le_read_buffer_size *size = (void *)rp;

		size->le_max_len = sys_cpu_to_le16(LE_ACL_MAX_LEN);
		size->le_max_num = LE_ACL_MAX_NUM;
		break;
	}
	case BT_HCI_OP_LE_READ_LOCAL_FEATURES: {
		struct bt_hci_rp_le_read_local_features *features = (void *)rp;

		(void)memcpy(features->features, test_le_features, sizeof(features->features));
		break;
	}
	case BT_HCI_OP_LE_READ_SUPP_STATES: {
		struct bt_hci_rp_le_read_supp_states *states = (void *)rp;

		(void)memset(states->le_states, 0xFF, sizeof(states->le_states));
		break;
	}
	default:
		break;
	}

	bt_hci_recv(hci_dev, evt);
}

static int send_err(const struct net_buf *buf)
{
	uint16_t opcode = sys_get_le16(buf->data);

	if (opcode == TEST_OPCODE) {
		return test_cmd.send_err;
	}

	if (opcode == BT_HCI_OP_DISCONNECT) {
		return test_disconnect.send_err;
	}

	if (opcode == test_other_opcode) {
		return test_other.send_err;
	}

	return 0;
}

static int driver_open(const struct device *dev)
{
	ARG_UNUSED(dev);

	return 0;
}

static int driver_close(const struct device *dev)
{
	ARG_UNUSED(dev);

	test_close_count++;

	return 0;
}

static int driver_send(const struct device *dev, struct net_buf *buf)
{
	ARG_UNUSED(dev);

	if (buf->data[0] == BT_HCI_H4_CMD) {
		int err;

		(void)net_buf_pull_u8(buf);

		err = send_err(buf);
		if (err != 0) {
			/* The buffer stays with the caller */
			return err;
		}

		cmd_handle(buf);
	} else if (buf->data[0] == BT_HCI_H4_ACL) {
		size_t hdr_len = 1U + sizeof(struct bt_hci_acl_hdr);

		test_acl_count++;
		(void)memset(test_acl_data, 0, sizeof(test_acl_data));
		if (buf->len > hdr_len) {
			(void)memcpy(test_acl_data, &buf->data[hdr_len],
				     MIN(buf->len - hdr_len, sizeof(test_acl_data)));
		}
	} else {
		/* Nothing else is looked at */
	}

	net_buf_unref(buf);

	return 0;
}

static DEVICE_API(bt_hci, driver_api) = {
	.open = driver_open,
	.close = driver_close,
	.send = driver_send,
};

void test_driver_reset(void)
{
	static const struct test_cmd_script respond_at_once = {
		.delay = K_NO_WAIT,
		.status = BT_HCI_ERR_SUCCESS,
		.ncmd = 1U,
	};

	(void)k_work_cancel_delayable(&cmd_rsp_work);
	(void)k_work_cancel_delayable(&disconnect_rsp_work);
	(void)k_work_cancel_delayable(&other_rsp_work);
	net_buf_drop(&kept_cmd);

	test_cmd = respond_at_once;
	test_disconnect = respond_at_once;
	test_other = respond_at_once;
	test_other_opcode = 0U;
	test_log_len = 0U;
	test_acl_count = 0U;
	test_reset_count = 0U;
	test_close_count = 0U;
	k_sem_reset(&script_sem);
}

void test_driver_release(void)
{
	bool is_cmd_held = (test_cmd.rsp_count < test_cmd.count);
	bool is_disconnect_held = (test_disconnect.rsp_count < test_disconnect.count);
	bool is_other_held = (test_other.rsp_count < test_other.count);
	uint16_t other_opcode = test_other_opcode;

	test_driver_reset();

	if (is_cmd_held) {
		test_cmd_respond(&test_cmd);
	}

	if (is_disconnect_held) {
		test_cmd_respond(&test_disconnect);
	}

	if (is_other_held) {
		/* The response names the command */
		test_other_opcode = other_opcode;
		test_cmd_respond(&test_other);
		test_other_opcode = 0U;
	}

	test_credit_grant();
}

#define TEST_DEVICE_INIT(inst)                                                                     \
	static struct bt_hci_driver_data driver_data_##inst = { 0 };                               \
	static const struct bt_hci_driver_config driver_config_##inst =                            \
		BT_DT_HCI_DRIVER_CONFIG_INST_GET(inst);                                            \
	DEVICE_DT_INST_DEFINE(inst, NULL, NULL, &driver_data_##inst, &driver_config_##inst,        \
			      POST_KERNEL, CONFIG_KERNEL_INIT_PRIORITY_DEVICE, &driver_api)

DT_INST_FOREACH_STATUS_OKAY(TEST_DEVICE_INIT)
```

## src/driver.h
```c
/*
 * SPDX-FileCopyrightText: Copyright (c) 2026 Silicon Laboratories Inc.
 * SPDX-License-Identifier: Apache-2.0
 */

#ifndef TESTS_BLUETOOTH_HOST_CMD_SRC_DRIVER_H_
#define TESTS_BLUETOOTH_HOST_CMD_SRC_DRIVER_H_

#include <stdbool.h>
#include <stdint.h>

#include <zephyr/bluetooth/addr.h>
#include <zephyr/bluetooth/hci_types.h>
#include <zephyr/devicetree.h>
#include <zephyr/kernel.h>
#include <zephyr/net_buf.h>

/* A vendor command that only the tests send */
#define TEST_OPCODE BT_OP(BT_OGF_VS, 0x03f0U)

/* How long a test waits for something that happens without time passing, as
 * a response from within send() or a work item that is due: the bound only
 * turns a hang into a failure.
 */
#define TEST_TIMEOUT K_SECONDS(1)

/* The command deadline of the Host in milliseconds. HCI_CMD_TIMEOUT comes from
 * hci_core.h, which the sources include themselves: it has no include guard.
 */
#define TEST_DEADLINE_MS ((int64_t)k_ticks_to_ms_floor64(HCI_CMD_TIMEOUT.ticks))

/* How far a measured wait for the deadline may be off: more than the few
 * ticks that the Host takes to act on the expiry and the waiter to return.
 */
#define TEST_DEADLINE_SLACK_MS 100U

/* A wait that is to end with the deadline gives up this much later */
#define TEST_PAST_DEADLINE K_MSEC(TEST_DEADLINE_MS + MSEC_PER_SEC)

/* More than the Host has command buffers in any configuration of the suites */
#define TEST_CMD_BUF_MAX 32U

/* How many TEST_OPCODE commands the controller keeps the parameter length of */
#define TEST_CMD_PLEN_MAX 4U

/* The handle of the connection that test_connect() brings up */
#define TEST_CONN_HANDLE 0x0001U

/* How many parameter bytes of the last test_other command the controller
 * keeps, how many opcodes it logs, how many bytes of the last ACL packet it
 * keeps, and the size of LE features
 */
#define TEST_OTHER_PARAMS_MAX 32U
#define TEST_LOG_MAX          16U
#define TEST_ACL_DATA_MAX     8U
#define TEST_LE_FEATURES_LEN  8U

/** What the test controller does with one command. It responds to every
 *  other command with success and one command credit from within send().
 */
struct test_cmd_script {
	/** When the response comes: K_NO_WAIT from within send(), K_FOREVER never */
	k_timeout_t delay;
	/** Status of the response */
	uint8_t status;
	/** Num_HCI_Command_Packets of the response */
	uint8_t ncmd;
	/** Length of the return parameters after the status (TEST_OPCODE only) */
	uint8_t rp_len;
	/** The return parameters repeat the first parameter byte of the command
	 *  instead of counting up (TEST_OPCODE only)
	 */
	bool echo;
	/** What send() returns instead of taking the command, if not 0 */
	int send_err;
	/** The controller keeps the buffer of the command, as a driver may,
	 *  until the next test_driver_reset() (test_other only)
	 */
	bool keep;
	/** How often the controller has been given the command */
	unsigned int count;
	/** How often the controller has responded to the command */
	unsigned int rsp_count;
};

/** TEST_OPCODE, whose response is a Command Complete event */
extern struct test_cmd_script test_cmd;

/** Parameter length of the first few TEST_OPCODE commands the controller got */
extern uint8_t test_cmd_plen[TEST_CMD_PLEN_MAX];

/** HCI Disconnect, whose response is a Command Status event, followed by a
 *  Disconnection Complete event when the status is success.
 */
extern struct test_cmd_script test_disconnect;

/** One more command, which a test picks by setting its opcode, whose response
 *  is a Command Status event. test_driver_reset() picks none.
 */
extern uint16_t test_other_opcode;
extern struct test_cmd_script test_other;

/** Parameters of the last command with test_other_opcode */
extern uint8_t test_other_params[TEST_OTHER_PARAMS_MAX];

/** A command that the controller responds to as it responds to the commands
 *  that bt_enable() sends, with a Command Complete event, but only once the
 *  test calls test_held_respond(): for a test that looks at what happens in
 *  the meantime. test_driver_reset() picks none.
 */
extern uint16_t test_held_opcode;

/** Status of the response to test_held_opcode */
extern uint8_t test_held_status;

/** How often the controller has been given test_held_opcode */
extern unsigned int test_held_count;

/** Wait until the controller has been given test_held_opcode @p count times,
 *  and holds its response to the last one.
 *
 *  @retval 0 It has.
 *  @retval -EAGAIN It has not within TEST_TIMEOUT of the last command.
 */
int test_held_wait(unsigned int count);

/** Send the response to test_held_opcode now, if the controller holds it */
void test_held_respond(void);

/** HCI version that the controller reports, 0 after test_driver_reset() */
extern uint8_t test_hci_version;

/** The controller has no public address, false after test_driver_reset() */
extern bool test_has_no_public_addr;

/** The opcodes of the commands that the controller has been given, in order,
 *  since the last test_driver_reset() or since a test set the length to zero.
 */
extern uint16_t test_log[TEST_LOG_MAX];
extern unsigned int test_log_len;

/** LE features that the controller reports. Not touched by test_driver_reset() */
extern uint8_t test_le_features[TEST_LE_FEATURES_LEN];

/** How many ACL packets the controller has been given since the last
 *  test_driver_reset(), and the first bytes of the last one behind its ACL
 *  header, which is where the L2CAP header starts.
 */
extern unsigned int test_acl_count;
extern uint8_t test_acl_data[TEST_ACL_DATA_MAX];

/** The peer of the connection that the test controller reports */
extern const bt_addr_le_t test_peer;

/** How often the controller has been reset and the transport closed */
extern unsigned int test_reset_count;
extern unsigned int test_close_count;

/** Back to a controller that responds at once, counters at zero */
void test_driver_reset(void);

/** As test_driver_reset(), and respond to a command that the controller holds
 *  and grant a command credit: what a failed test leaves for bt_disable(),
 *  whose HCI Reset is to get through.
 */
void test_driver_release(void);

/** Deliver the response of a scripted command now */
void test_cmd_respond(struct test_cmd_script *script);

/** Wait until the controller has been given @p count commands of @p script.
 *
 *  @retval 0 It has.
 *  @retval -EAGAIN It has not within TEST_TIMEOUT of the last one.
 */
int test_cmd_wait(const struct test_cmd_script *script, unsigned int count);

/** Wait until the controller has responded @p count times to the commands of
 *  @p script.
 *
 *  @retval 0 It has.
 *  @retval -EAGAIN It has not within TEST_TIMEOUT of the last response.
 */
int test_rsp_wait(const struct test_cmd_script *script, unsigned int count);

/** Wait until @p queue has run what has been submitted to it */
void test_workq_flush(struct k_work_q *queue);

/** Wait until the Bluetooth workqueue has run what has been submitted to it */
void test_bt_workq_flush(void);

/** Let every thread run until it waits, for a check of something that nothing
 *  signals: a command that must not have been sent, or a thread that is to
 *  have blocked.
 */
void test_settle(void);

/** Command buffers that a test holds, NULL where none is held */
extern struct net_buf *test_cmd_bufs[TEST_CMD_BUF_MAX];

/** Take every free command buffer into test_cmd_bufs.
 *
 *  @return How many there were.
 */
unsigned int test_cmd_bufs_hold(void);

/** Free the command buffers in test_cmd_bufs */
void test_cmd_bufs_release(void);

/** Check that the command pool has all of its buffers, and counts them right */
void test_cmd_pool_check(void);

/** Deliver a Command Complete event for no command that grants a command credit */
void test_credit_grant(void);

/** Deliver a Command Complete event for no command that takes the credit back */
void test_credit_revoke(void);

/** Whether the Host resets the test controller, which it does unless the
 *  devicetree gives the controller the "no-reset" quirk.
 */
#define TEST_DRIVER_RESETS (!DT_NODE_HAS_PROP(DT_NODELABEL(bt_hci_test), bt_hci_quirks))

/** Suite predicates: most suites need the reset, one cannot do with it */
bool test_with_reset(const void *state);
bool test_without_reset(const void *state);

/** Deliver an LE Connection Complete event for TEST_CONN_HANDLE, peripheral role */
void test_connect(void);

/** The same in the central role, for a connection that the Host is creating */
void test_connect_central(void);

/** Deliver an Encryption Change event for TEST_CONN_HANDLE */
void test_encrypt_change(uint8_t status);

/** Deliver an L2CAP PDU from the peer of TEST_CONN_HANDLE */
void test_acl_recv(uint16_t cid, const uint8_t *data, uint8_t len);

/** Deliver a Disconnection Complete event for TEST_CONN_HANDLE */
void test_disconnect_complete(uint8_t reason);

/** Deliver an LE Read Remote Features Complete event for TEST_CONN_HANDLE */
void test_remote_features(const uint8_t features[TEST_LE_FEATURES_LEN]);

#endif /* TESTS_BLUETOOTH_HOST_CMD_SRC_DRIVER_H_ */
```
