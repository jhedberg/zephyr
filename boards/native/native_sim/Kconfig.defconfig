## dts/bindings/bluetooth/zephyr,bsim-2g4-radio.yaml
```yaml
# Copyright The Zephyr Project Contributors
# SPDX-License-Identifier: Apache-2.0

description: |
  Packet level 2.4GHz radio model for BabbleSim based boards.

  The radio model runs in the native simulator runner and talks to the
  BabbleSim 2G4 Phy. It provides a free running 1MHz counter and Bluetooth LE
  packet Tx/Rx, signalled through the interrupts given here.

  When this node is enabled, the Zephyr Bluetooth LE Controller (a
  "zephyr,bt-hci-ll-sw-split" node, which can be a child of this node or one
  the board already has) uses the BabbleSim LLL on top of this model instead
  of a vendor LLL.

compatible: "zephyr,bsim-2g4-radio"

include: base.yaml

properties:
  interrupts:
    required: true

  interrupt-names:
    required: true
    description: |
      Must contain "radio" (end of a radio operation), "cntr" (counter
      compare), "swi-lll" and "swi-ull-low" (software interrupts used by the
      Controller).
```

## dts/bindings/interrupt-controller/zephyr,native-sim-intc.yaml
```yaml
# Copyright The Zephyr Project Contributors
# SPDX-License-Identifier: Apache-2.0

description: |
  Interrupt controller of the native simulator.

  The native_sim drivers use fixed interrupt lines, so the board does not
  need this node, but models that take their interrupt lines from the
  devicetree, like the BabbleSim packet level radio model, need it as their
  interrupt parent.

compatible: "zephyr,native-sim-intc"

include: [interrupt-controller.yaml, base.yaml]

properties:
  "#interrupt-cells":
    const: 2

interrupt-cells:
  - irq
  - priority
```
